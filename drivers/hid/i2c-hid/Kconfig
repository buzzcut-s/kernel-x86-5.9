## drivers/hid/i2c-hid/Kconfig
```kconfig
# SPDX-License-Identifier: GPL-2.0-only
menu "I2C HID support"
	depends on I2C

config I2C_HID
	tristate "HID over I2C transport layer"
	default n
	depends on I2C && INPUT
	select HID
	help
	  Say Y here if you use a keyboard, a touchpad, a touchscreen, or any
	  other HID based devices which is connected to your computer via I2C.

	  If unsure, say N.

	  This support is also available as a module.  If so, the module
	  will be called i2c-hid.

if I2C_HID
config I2C_HID_USE_BLOCK_READS
	bool "Use block reads to save power"
	default y
	help
	  Say Y here if you have an i2c controller with a driver that has
	  proper I2C_M_RECV_LEN functionality and is not limited to the old
	  SMBus standard of 32 bytes per block read.
endif

endmenu
```
